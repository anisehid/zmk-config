## boards/anisehid/anisectlc/Kconfig.defconfig
```kconfig
# Copyright (c) 2020 The ZMK Contributors
# SPDX-License-Identifier: MIT

if BOARD_ANISECTLC

config BOARD_ENABLE_DCDC
    bool "Enable DCDC mode"
    select SOC_DCDC_NRF52X
    default y

config BT_CTLR
    default BT

endif # BOARD_ANISECTLC
```

## boards/anisehid/anisectlc/board.yml
```yaml
boards:
  - name: anisectlc
    vendor: anisehid
    socs:
      - name: nrf52840
        variants:
          - name: zmk
```

## boards/anisehid/anisectlp/board.yml
```yaml
boards:
  - name: anisectlp
    vendor: anisehid
    socs:
      - name: nrf52840
        variants:
          - name: zmk
```

## config/boards/shields/anise60b_hhkb/Kconfig.defconfig
```kconfig
if SHIELD_ANISE60B_HHKB_LEFT

config ZMK_KEYBOARD_NAME
	default "ANISE60B-HHKB"

config ZMK_SPLIT_ROLE_CENTRAL
	default y

endif

if SHIELD_ANISE60B_HHKB_LEFT || SHIELD_ANISE60B_HHKB_RIGHT

config ZMK_SPLIT
	default y

endif
```

## config/boards/shields/anise60b_hhkb/Kconfig.shield
```kconfig
config SHIELD_ANISE60B_HHKB_LEFT
	def_bool $(shields_list_contains,anise60b_hhkb_left)

config SHIELD_ANISE60B_HHKB_RIGHT
	def_bool $(shields_list_contains,anise60b_hhkb_right)
```

## config/boards/shields/anise60b_keyd/Kconfig.shield
```kconfig
config SHIELD_ANISE60B_KEYD_LEFT
	def_bool $(shields_list_contains,anise60b_keyd_left)

config SHIELD_ANISE60B_KEYD_RIGHT
	def_bool $(shields_list_contains,anise60b_keyd_right)
```

## config/boards/shields/anise60b_mac/Kconfig.defconfig
```kconfig
if SHIELD_ANISE60B_MAC_LEFT

config ZMK_KEYBOARD_NAME
	default "ANISE60B-MAC"

config ZMK_SPLIT_ROLE_CENTRAL
	default y

endif

if SHIELD_ANISE60B_MAC_LEFT || SHIELD_ANISE60B_MAC_RIGHT

config ZMK_SPLIT
	default y

endif
```

## config/boards/shields/anise60b_mac/Kconfig.shield
```kconfig
config SHIELD_ANISE60B_MAC_LEFT
	def_bool $(shields_list_contains,anise60b_mac_left)

config SHIELD_ANISE60B_MAC_RIGHT
	def_bool $(shields_list_contains,anise60b_mac_right)
```

## config/boards/shields/anise60b_vim/Kconfig.shield
```kconfig
config SHIELD_ANISE60B_VIM_LEFT
	def_bool $(shields_list_contains,anise60b_vim_left)

config SHIELD_ANISE60B_VIM_RIGHT
	def_bool $(shields_list_contains,anise60b_vim_right)
```

## config/boards/shields/anise60b_win/Kconfig.defconfig
```kconfig
if SHIELD_ANISE60B_WIN_LEFT

config ZMK_KEYBOARD_NAME
	default "ANISE60B-WIN"

config ZMK_SPLIT_ROLE_CENTRAL
	default y

endif

if SHIELD_ANISE60B_WIN_LEFT || SHIELD_ANISE60B_WIN_RIGHT

config ZMK_SPLIT
	default y

endif
```

## config/boards/shields/anise60b_win/Kconfig.shield
```kconfig
config SHIELD_ANISE60B_WIN_LEFT
	def_bool $(shields_list_contains,anise60b_win_left)

config SHIELD_ANISE60B_WIN_RIGHT
	def_bool $(shields_list_contains,anise60b_win_right)
```

## config/boards/shields/anise85a_keyd/Kconfig.defconfig
```kconfig
if SHIELD_ANISE85A_KEYD_LEFT

config ZMK_KEYBOARD_NAME
	default "ANISE85A-KEYD"

config ZMK_SPLIT_ROLE_CENTRAL
	default y

endif

if SHIELD_ANISE85A_KEYD_LEFT || SHIELD_ANISE85A_KEYD_RIGHT

config ZMK_SPLIT
	default y

endif
```

## config/boards/shields/anise85a_keyd/Kconfig.shield
```kconfig
config SHIELD_ANISE85A_KEYD_LEFT
	def_bool $(shields_list_contains,anise85a_keyd_left)

config SHIELD_ANISE85A_KEYD_RIGHT
	def_bool $(shields_list_contains,anise85a_keyd_right)
```
