#include <behaviors.dtsi>

/* Every position is &none: the probe only needs the kscan log lines. */
/ {
    keymap {
        compatible = "zmk,keymap";
        default_layer {
            bindings = <&none>;
        };
    };
};
